#include "glove80_shared.dtsi"

&pinctrl {
    /* SCLK = EXT6 = P1.00 */
    /* SDIO = EXT5 = P0.22 */

    spi0_default {
        psels = SPI_PSELS(1, 0, 0, 22)
    };

    spi0_sleep {
        psels = SPI_PSELS(1, 0, 0, 22)
        low-power-enable;
    };
};

// enable the trackball
&spi0 {
    status = "okay";
};

// sending input to left hand over BLE
&trackball_split {
    device = <&trackball>;

    // Optional
    // input-processors = <&zip_xy_transform (INPUT_TRANSFORM_XY_SWAP | INPUT_TRANSFORM_X_INVERT | INPUT_TRANSFORM_Y_INVERT)>;
};

&switch_inputs {
    status = "okay";
};