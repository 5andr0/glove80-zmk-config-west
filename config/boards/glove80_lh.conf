## config/boards/glove80_lh.conf
```kconfig
CONFIG_SPI=y
CONFIG_INPUT=y
CONFIG_ZMK_POINTING=y
CONFIG_ZMK_BLE=y
CONFIG_ZMK_USB=y
CONFIG_PMW3610=y
# CONFIG_PMW3610_SWAP_XY=y
# CONFIG_PMW3610_INVERT_X=y
# CONFIG_PMW3610_INVERT_Y=y
# CONFIG_PMW3610_REPORT_INTERVAL_MIN=12
CONFIG_PMW3610_LOG_LEVEL_DBG=y
CONFIG_PMW3610_INIT_POWER_UP_EXTRA_DELAY_MS=3000
CONFIG_ZMK_USB_LOGGING=y
CONFIG_ZMK_MOUSE=y
CONFIG_ZMK_HID_REPORT_MOUSE=y
CONFIG_ZMK_BLE_HID_MOUSE=y
CONFIG_ZMK_USB_HID_REPORT_MOUSE=y
```

## config/west.yml
```yaml
manifest:
  remotes:
    - name: moergo-sc
      url-base: https://github.com/moergo-sc
    - name: Cy0n1x
      url-base: https://github.com/Cy0n1x
  projects:
    - name: zmk
      remote: moergo-sc
      revision: main
      import: app/west.yml
    - name: glove80-sidecar-module
      remote: Cy0n1x
      revision: main
      import: west.yml
  self:
    path: config
```
